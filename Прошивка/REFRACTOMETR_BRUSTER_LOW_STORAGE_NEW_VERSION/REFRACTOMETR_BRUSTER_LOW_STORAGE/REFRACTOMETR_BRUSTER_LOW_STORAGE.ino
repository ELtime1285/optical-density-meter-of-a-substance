//...................INCLUDES...................//
#include "InterpolationLib.h" //..............Подключение библиотеки для работы с интерполяцией
#include <GyverFilters.h>     //..............Подключение библиотеки для работы с медианным фильтром
#include <Servo.h>            //..............Подключение библиотеки для работы с сервоприводом
//.....................PINS.....................//
#define PIN_LED 8             //..............Пин подключения светодиода
#define PIN_SERVO 9           //..............Пин подключения сервопривода
//....................OBJECT....................//
Servo myServo;                // .............Инициализация обьекта класса Servo
const int n = 7;              //..............Количество повторных измерений
double minimum = 9999.0;      //..............Переменная для хранения минимума
float SREDznach[90];          //..............Иннициализация массива для хранения среднего значения ацп при каждом угле
float filtred[90];            //..............Иннициализация массива для значений медианного фильтра
void setup() {
//.....Иннициализация....// 
for(int i =0;i<90;i++)SREDznach[i] = 0.0;//.....Очистка массива 
  Serial.begin(115200);         //..............Инициализация консоли отладки
  pinMode(A0,INPUT);            // .............Инициализация входа солнечной панели
  pinMode(PIN_LED,OUTPUT);      // .............Инициализация выхода светодиода
  digitalWrite(PIN_LED,1);      // .............Установка светодиода во вкл. положение
  myServo.attach(PIN_SERVO);    //..............Инициализация сервопривода
//.....Работа устройства....// 
for(int j = 0;j<n;j++){       //
  for(int i = 0;i<90;i++){    //
  myServo.write(i);           //.......................Установка заданного угла
  delay(40);                  //.......................Задержка для корректной работы
  SREDznach[i]+=analogRead(A0);//......................Запись значений напряжений в единицах измерения размерности АЦП
 }                            // 
}                             //

myServo.write(0);             //.......................Установка сервопривода в домашнее положение
delay(40);                    //.......................Здаержка в 40 мс.
  for(int i = 0;i<90;i++)SREDznach[i]/=(float)n;//.....Найти среднее значание повторных измерений при каждом угле
                    
//........Обработка данных........// 
//.....Медианный фильтр....// 

GMedian<3, float> median;     //.......................Иннициализация медианного фильтра
for(int i = 0;i<90;i++)filtred[i]=median.filtered(SREDznach[i]);//Запись значений медианного фильтра в массив
for(int i = 0;i<=8;i++)filtred[i]=filtred[8];//........Приравнивание начальным точкам значение 8 элемента для избегания ошибок на границах графика

//.....Интерполяция....// 
double yFilter[24];//.......Массив для хранения исходных значений выбранного диапазона с медианного фильтра 
double angle[24];  //.......Массив для хранения углов этого диапазона (от начального и до конечного)
for(int i = 45;i<=68;i++)yFilter[i-45] = (double)filtred[i];//....Присваивание значений медианного фильтра выбранного диапазона
for(int i = 45;i<=68;i++)angle[(i-45)] = (double)i;//.............Присваиваниезначений углов соответсвенным значениям
double q = 0.25;//................................................Период между интерполяционными точками
double interpolation[(const int)(24/q)];//........................Иннициализация массива для хранения значений интерполяционных точек
Serial.print("Интерполяционный график");//........................Отладка
for (float xValue = 0.0; xValue <= 23.0; xValue += q){
  interpolation[(const int)(xValue/q)] = Interpolation::CatmullSpline(angle, yFilter, 24, xValue+45.0); //Присваивание каждой ячейки массива                                                                                                     // ее соотвествующю интерполяционную точку
   Serial.print(xValue + 45.0);//................................Вывод конкретного угла
   Serial.print('\t');//.........................................Табуляция
   Serial.println(interpolation[(const int)(xValue/q)]);//.......Вывод соответствующего значения
  }
//.....Нахождение минимума....//
int min_i= 0;//..................................................Иннициализация переменной ячейки массива минимального интерполяционного значения
double minDeg = 0;//.............................................Иннициализация переменной угла минимального интерполяционного значения

for(int i = 0; i < (int)(23/q); i++){
   if(fmin(interpolation[i], minimum)!=minimum && interpolation[i] != 0.00)//Проверка минимального значения
   {minimum=fmin(interpolation[i], minimum);//...............................Присваивание минимального значения 
   min_i = i;//..............................................................Присваивание минимальной ячейки
   Serial.print("Minimum:");         //
   Serial.print('\t');               //
   Serial.print("i:");               //
   Serial.print(min_i);              // Отладка
   Serial.print('\t');               //
   Serial.print("ADC intensity: ");  //
   Serial.println(interpolation[i]); //
   } 
}
Serial.println("////////////////////////////////////////////////////");
minDeg = (int)(min_i * q)+45.0;//................Перевод из значений минимальной ячейки в угол
Serial.print("Угол Брюстера: ");//...............Отладка
Serial.print(minDeg);//..........................Вывод минимального угла - угла Брюстера
Serial.println("°");//...........................Отладка
Serial.print("Оптическая плотность: ");//........Отладка
Serial.println(tan(radians(minDeg)),5);//........Вывод значений оптической плотности вещества
Serial.println("////////////////////////////////////////////////////");
Serial.println("Вывод угла, усредненных значений и значений медианного фильтра");//...Отладка
for(int i = 0;i<90;i++){          //
  Serial.println();               //
  Serial.print(i);                //
  Serial.print('\t');             //
  Serial.print(SREDznach[i]);     // Отладка и вывод значений
  Serial.print('\t');             //
  Serial.print(filtred[i]);       //
  Serial.print('\t');             //
}                                 //
Serial.println();                 //
}
void loop() {
}
